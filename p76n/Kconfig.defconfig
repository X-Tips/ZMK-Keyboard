## p76n/Kconfig.defconfig
```kconfig
# Copyright (c) 2020 The ZMK Contributors
# SPDX-License-Identifier: MIT

if SHIELD_p76n

config ZMK_KEYBOARD_NAME
	default "X.P76n Keyboard"

endif
```

## p76n/Kconfig.shield
```kconfig
# Copyright (c) 2020 The ZMK Contributors
# SPDX-License-Identifier: MIT

config SHIELD_p76n
	def_bool $(shields_list_contains,p76n)
```
