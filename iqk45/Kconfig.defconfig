## iqk45/Kconfig.defconfig
```kconfig
# Copyright (c) 2020 The ZMK Contributors
# SPDX-License-Identifier: MIT

if SHIELD_iqk45

config ZMK_KEYBOARD_NAME
	default "X.Tips Keyboard"

endif
```

## iqk45/Kconfig.shield
```kconfig
# Copyright (c) 2020 The ZMK Contributors
# SPDX-License-Identifier: MIT

config SHIELD_iqk45
	def_bool $(shields_list_contains,iqk45)
```

## iqp64/Kconfig.defconfig
```kconfig
# Copyright (c) 2020 The ZMK Contributors
# SPDX-License-Identifier: MIT

if SHIELD_iqp64

config ZMK_KEYBOARD_NAME
	default "X.Tips Keyboard"

endif
```

## iqp64/Kconfig.shield
```kconfig
# Copyright (c) 2020 The ZMK Contributors
# SPDX-License-Identifier: MIT

config SHIELD_iqp64
	def_bool $(shields_list_contains,iqp64)
```

## iqx3/Kconfig.shield
```kconfig
# Copyright (c) 2020 The ZMK Contributors
# SPDX-License-Identifier: MIT

config SHIELD_iqx3
	def_bool $(shields_list_contains,iqx3)
```

## iqx4/Kconfig.defconfig
```kconfig
# Copyright (c) 2020 The ZMK Contributors
# SPDX-License-Identifier: MIT

if SHIELD_iqx4

config ZMK_KEYBOARD_NAME
	default "X.Tips Keyboard"

endif
```

## p20n/Kconfig.defconfig
```kconfig
# Copyright (c) 2020 The ZMK Contributors
# SPDX-License-Identifier: MIT

if SHIELD_p20n

config ZMK_KEYBOARD_NAME
	default "X.P20n Keyboard"

endif
```

## p20n/Kconfig.shield
```kconfig
# Copyright (c) 2020 The ZMK Contributors
# SPDX-License-Identifier: MIT

config SHIELD_p20n
	def_bool $(shields_list_contains,p20n)
```

## p21n/Kconfig.defconfig
```kconfig
# Copyright (c) 2020 The ZMK Contributors
# SPDX-License-Identifier: MIT

if SHIELD_p21n

config ZMK_KEYBOARD_NAME
	default "X.Tips Ble KB"

endif
```

## p21n/Kconfig.shield
```kconfig
# Copyright (c) 2020 The ZMK Contributors
# SPDX-License-Identifier: MIT

config SHIELD_p21n
	def_bool $(shields_list_contains,p21n)
```

## p31n/Kconfig.defconfig
```kconfig
# Copyright (c) 2020 The ZMK Contributors
# SPDX-License-Identifier: MIT

if SHIELD_p31n

config ZMK_KEYBOARD_NAME
	default "X.P31n Keyboard"

endif
```

## p31n/p31n/Kconfig.shield
```kconfig
# Copyright (c) 2020 The ZMK Contributors
# SPDX-License-Identifier: MIT

config SHIELD_p31n
	def_bool $(shields_list_contains,p31n)
```

## p48n/Kconfig.defconfig
```kconfig
# Copyright (c) 2020 The ZMK Contributors
# SPDX-License-Identifier: MIT

if SHIELD_p48n

config ZMK_KEYBOARD_NAME
	default "X.p48n Keyboard"

endif
```

## p61n/Kconfig.defconfig
```kconfig
# Copyright (c) 2020 The ZMK Contributors
# SPDX-License-Identifier: MIT

if SHIELD_p61n

config ZMK_KEYBOARD_NAME
	default "X.p61n Keyboard"

endif
```

## p61n/Kconfig.shield
```kconfig
# Copyright (c) 2020 The ZMK Contributors
# SPDX-License-Identifier: MIT

config SHIELD_p61n
	def_bool $(shields_list_contains,p61n)
```

## x35n/Kconfig.shield
```kconfig
# Copyright (c) 2020 The ZMK Contributors
# SPDX-License-Identifier: MIT

config SHIELD_x35n
	def_bool $(shields_list_contains,x35n)
```

## x36n/Kconfig.defconfig
```kconfig
# Copyright (c) 2020 The ZMK Contributors
# SPDX-License-Identifier: MIT

if SHIELD_x36n

config ZMK_KEYBOARD_NAME
	default "X.Tips X36n-kb"

endif
```

## x36n/Kconfig.shield
```kconfig
# Copyright (c) 2020 The ZMK Contributors
# SPDX-License-Identifier: MIT

config SHIELD_x36n
	def_bool $(shields_list_contains,x36n)
```

## x3n/Kconfig.shield
```kconfig
# Copyright (c) 2020 The ZMK Contributors
# SPDX-License-Identifier: MIT

config SHIELD_x3n
	def_bool $(shields_list_contains,x3n)
```

## x3n2/Kconfig.defconfig
```kconfig
# Copyright (c) 2020 The ZMK Contributors
# SPDX-License-Identifier: MIT

if SHIELD_x3n2

config ZMK_KEYBOARD_NAME
	default "X.Tips x3n2-kb"

endif
```

## x3n2/Kconfig.shield
```kconfig
# Copyright (c) 2020 The ZMK Contributors
# SPDX-License-Identifier: MIT

config SHIELD_x3n2
	def_bool $(shields_list_contains,x3n2)
```
